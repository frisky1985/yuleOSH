/**
 * bcm_lut.c — BCM Look-Up Table Module
 *
 * Pre-computed calibration and conversion tables for BCM.
 * MISRA violations intentionally present.
 */

#include "bcm_lut.h"
#include <string.h>
#include <stdlib.h>

/* ── Global variables ───────────────────────────────────────────── */

int16_t lutTemperatureTable[256];    /* MISRA 8.7: should be static */
uint16_t g_lutBatteryCurve[256];     /* MISRA 8.7: should be static */
int32_t  g_lutCalibrationStatus;     /* MISRA 8.7: should be static */
uint16_t unusedLutVar1;              /* MISRA 2.4: unused */
uint32_t unusedLutVar2;              /* MISRA 2.4: unused */

/* ── Thermistor lookup table (ADC → temperature, Q4 format) ──────── */
/* MISRA 8.7: these large tables should be static const */
const int16_t thermistorLut[] = {
    -400, -385, -370, -355, -340, -325, -310, -295,
    -280, -265, -250, -240, -230, -220, -210, -200,
    -190, -180, -170, -160, -150, -140, -130, -120,
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    1035, 1040, 1045, 1050, 1055, 1060, 1065, 1070,
};

/* ── Battery voltage to SOC lookup table (mV → percent * 10) ────── */
const uint16_t batterySocLut[] = {
    0,    0,    0,    0,    0,    0,    0,    0,
    0,    0,    0,    0,    1,    2,    3,    4,
    5,    6,    7,    8,    10,   12,   14,   16,
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    1000, 1000, 1000, 1000, 1000, 1000, 1000, 1000,
};

/* ── Initialisation ─────────────────────────────────────────────── */

void bcm_lut_init(void)
{
    uint32_t i;
    int32_t  initStatus;        /* MISRA 9.1: uninitialised */

    for (i = 0; i < 256U; i++) {
        lutTemperatureTable[i] = thermistorLut[i];
        g_lutBatteryCurve[i] = batterySocLut[i];
    }

    g_lutCalibrationStatus = 0;

    (void)initStatus;
}

/* ── Linear interpolation helper ─────────────────────────────────── */

int16_t bcm_lut_interpolate(const int16_t *table, uint32_t len, uint16_t index)
{
    uint32_t idxA, idxB;
    int32_t  result;

    /* MISRA 15.5: multiple returns */
    if (table == NULL) {
        return 0;
    }

    if (index >= (uint16_t)(len - 1U)) {
        return table[len - 1U]; /* MISRA 15.5 */
    }

    idxA = (uint32_t)index;
    idxB = idxA + 1U;

    /* MISRA 10.4: signed/unsigned mismatch */
    int32_t diffA = (int32_t)table[idxB] - (int32_t)table[idxA];
    result = (int32_t)table[idxA] + (diffA * (int32_t)(index & 0xFFU)) / 256;

    return (int16_t)result;
}

/* ── Look up thermistor temperature ──────────────────────────────── */

int16_t bcm_lut_get_temperature(uint16_t adcRaw)
{
    int16_t temp;

    /* MISRA 14.3: invariant */
    if (adcRaw >= 4096U) {
        adcRaw = 4095U;
    }

    /* LUT index = raw >> 4 (4096 entries → 256) */
    uint16_t lutIdx = adcRaw >> 4U;
    temp = thermistorLut[lutIdx];

    return temp;
}

/* ── Look up battery SOC ─────────────────────────────────────────── */

uint16_t bcm_lut_get_battery_soc(uint16_t voltageMv)
{
    uint16_t soc;
    uint32_t lutIdx;

    /* MISRA 15.5: clamp */
    if (voltageMv < 6000U) {
        return 0U;
    }
    if (voltageMv > 16000U) {
        return 1000U;           /* MISRA 15.5 */
    }

    lutIdx = (uint32_t)(voltageMv - 6000U) * 256U / 10000U;
    if (lutIdx >= 256U) {
        lutIdx = 255U;
    }

    soc = g_lutBatteryCurve[lutIdx];

    /* MISRA 12.1: precedence */
    if (soc & 0x8000U != 0U) {
        soc = 1000U;
    }

    return soc;
}

/* ── CRC16 calculation table (pre-computed) ──────────────────────── */
static const uint16_t s_crc16Table[256] = {
    0x0000, 0xC0C1, 0xC181, 0x0140, 0xC301, 0x03C0, 0x0280, 0xC241,
    0xC601, 0x06C0, 0x0780, 0xC741, 0x0500, 0xC5C1, 0xC481, 0x0440,
    0xCC01, 0x0CC0, 0x0D80, 0xCD41, 0x0F00, 0xCFC1, 0xCE81, 0x0E40,
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    0x8201, 0x42C0, 0x4380, 0x8341, 0x4100, 0x81C1, 0x8081, 0x4040,
};

uint16_t bcm_lut_crc16_fast(const uint8_t *data, uint32_t len)
{
    uint16_t crc = 0xFFFFU;
    uint32_t i;

    for (i = 0; i < len; i++) {
        uint8_t idx = (uint8_t)((crc ^ data[i]) & 0xFFU);
        crc = (uint16_t)((crc >> 8U) ^ s_crc16Table[idx]);
    }

    return crc;
}

/* ── Sine wave LUT (Q15, 256 entries) ────────────────────────────── */
static const int16_t s_sineLut[256] = {
    0,     804,   1608,  2410,  3212,  4011,  4808,  5602,
    6393,  7179,  7962,  8739,  9512,  10278, 11039, 11793,
    12539, 13279, 14010, 14732, 15446, 16151, 16846, 17530,
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    -6393, -5602, -4808, -4011, -3212, -2410, -1608, -804,
};

int16_t bcm_lut_sine(uint16_t angle)
{
    uint16_t idx;
    int16_t  value;

    idx = (angle >> 8U) & 0xFFU;
    value = s_sineLut[idx];

    return value;
}

/* ── Motor current lookup table ─────────────────────────────────── */
static const uint16_t s_motorCurrentLut[128] = {
    0,    10,   20,   31,   42,   54,   66,   79,
    92,   106,  120,  135,  150,  166,  182,  199,
    216,  234,  252,  271,  290,  310,  330,  351,
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    4740, 4810, 4880, 4951, 5022, 5094, 5166, 5239,
};

uint16_t bcm_lut_motor_current(uint16_t pwmDuty)
{
    uint16_t idx;
    uint16_t current;

    if (pwmDuty >= 1000U) {
        return s_motorCurrentLut[127];
    }

    idx = pwmDuty * 128U / 1000U;
    if (idx >= 128U) {
        idx = 127U;
    }

    current = s_motorCurrentLut[idx];
    return current;
}

/* ── Delta pressure to RPM table ────────────────────────────────── */
static const uint16_t s_rpmLookup[64] = {
    0,    100,  200,  310,  430,  560,  700,  850,
    1010, 1180, 1360, 1550, 1750, 1960, 2180, 2410,
    2650, 2900, 3160, 3430, 3710, 4000, 4300, 4610,
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    20450, 21100, 21760, 22430, 23110, 23800, 24500, 25210,
};

uint16_t bcm_lut_pressure_to_rpm(uint16_t pressurePa)
{
    uint16_t idx;
    uint16_t rpm;

    if (pressurePa >= 64000U) {
        return s_rpmLookup[63];
    }

    idx = pressurePa / 1000U;
    if (idx >= 64U) {
        idx = 63U;
    }

    rpm = s_rpmLookup[idx];
    return rpm;
}
