AUTOSAR XML (schema 422)
package /CanStack/SwcComponents
  application sw component type CanIf
    4 x port prototype:
      CanRxData: provided-interface=/CanStack/Interfaces/CanRxInterface
      CanTxData: required-interface=/CanStack/Interfaces/CanTxInterface
      CanIfConfig: provided-interface=/CanStack/Interfaces/CanIfConfigInterface
      CanIfStatus: provided-interface=/CanStack/Interfaces/CanIfStatusInterface
    behavior CanIfBehavior
      exclusive area CanIfExclusive
      runnable CanIf_RxIndication: data-read-access=target=/CanStack/SwcComponents/CanIf/CanRxData, data-write-access=target=/CanStack/SwcComponents/CanIf/CanTxData, event=data-received-event=target=/CanStack/SwcComponents/CanIf/CanRxData
      runnable CanIf_TxConfirmation: minimum-start-interval=1.0, event=timing-event=period=0.01
      runnable CanIf_MainFunction: minimum-start-interval=1.0, event=timing-event=period=0.01
  complex device driver sw component type CanSm
    port prototype CanSmState: required-interface=/CanStack/Interfaces/CanSmStateInterface
    port prototype CanSmControl: provided-interface=/CanStack/Interfaces/CanSmControlInterface
    behavior CanSmBehavior
      runnable CanSm_MainFunction: minimum-start-interval=5.0, event=timing-event=period=0.005
      runnable CanSm_StateChange: data-read-access=target=/CanStack/SwcComponents/CanSm/CanSmState, data-write-access=target=/CanStack/SwcComponents/CanSm/CanSmControl
