## templates/esp-idf-blinky/main/Kconfig.projbuild
```kconfig
menu "yuleOSH Blinky Configuration"

    config BLINK_GPIO
        int "LED GPIO number"
        range 0 39
        default 2
        help
            GPIO pin number connected to the LED.

endmenu
```
